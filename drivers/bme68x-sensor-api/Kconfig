## drivers/bme68x-sensor-api/Kconfig
```kconfig
# Copyright (c) 2024, Chris Duf
#
# SPDX-License-Identifier: Apache-2.0

menuconfig MY_BME68X_SENSOR_API_DRIVER
	bool "BME68X Sensor API (Driver)"
	default y if DT_HAS_BOSCH_MY_BME68X_SENSOR_API_ENABLED
	select MY_BME68X_SENSOR_API
	select I2C if $(dt_compat_on_bus,$(DT_COMPAT_BOSCH_MY_BME68X_SENSOR_API),i2c)
	select SPI if $(dt_compat_on_bus,$(DT_COMPAT_BOSCH_MY_BME68X_SENSOR_API),spi)
	help
	  Bosch Sensortec BME68X Sensor API integration with Zephyr-RTOS.

	  Bind Zephyr devices with "bosch,bme68x-sensor-api" bindings
	  to BME68X Sensor API sensors.

if MY_BME68X_SENSOR_API_DRIVER

config MY_BME68X_SENSOR_API_DRIVER_INIT_PRIORITY
	int "Relative initialization priority"
	default 99
	help
	   Within each initialization level you may specify a priority level,
 	   relative to other devices in the same initialization level.
 	   The priority level is specified as an integer value in the range 0 to 99;
 	   lower values indicate earlier initialization.

choice MY_BME68X_SENSOR_API_DRIVER_LOG_LEVEL_CHOICE
	prompt "Max compiled-in log level"
	default MY_BME68X_SENSOR_API_DRIVER_LOG_LEVEL_DEFAULT
	depends on LOG

config MY_BME68X_SENSOR_API_DRIVER_LOG_LEVEL_OFF
	bool "Off"
config MY_BME68X_SENSOR_API_DRIVER_LOG_LEVEL_ERR
	bool "Error"
config MY_BME68X_SENSOR_API_DRIVER_LOG_LEVEL_WRN
	bool "Warning"
config MY_BME68X_SENSOR_API_DRIVER_LOG_LEVEL_INF
	bool "Info"
config MY_BME68X_SENSOR_API_DRIVER_LOG_LEVEL_DBG
	bool "Debug"
config MY_BME68X_SENSOR_API_DRIVER_LOG_LEVEL_DEFAULT
	bool "Default"

endchoice

config MY_BME68X_SENSOR_API_DRIVER_LOG_LEVEL
	int
	depends on LOG
	default 0 if MY_BME68X_SENSOR_API_DRIVER_LOG_LEVEL_OFF
	default 1 if MY_BME68X_SENSOR_API_DRIVER_LOG_LEVEL_ERR
	default 2 if MY_BME68X_SENSOR_API_DRIVER_LOG_LEVEL_WRN
	default 3 if MY_BME68X_SENSOR_API_DRIVER_LOG_LEVEL_INF
	default 4 if MY_BME68X_SENSOR_API_DRIVER_LOG_LEVEL_DBG
	default LOG_DEFAULT_LEVEL if MY_BME68X_SENSOR_API_DRIVER_LOG_LEVEL_DEFAULT

endif # MY_BME68X_SENSOR_API_DRIVER
```

## lib/bme68x-iaq/Kconfig
```kconfig
# Copyright (c) 2024, Chris Duf
#
# SPDX-License-Identifier: Apache-2.0

menuconfig MY_BME68X_IAQ
	bool "Support library for BSEC IAQ"
	depends on BSEC
	depends on MY_BME68X_SENSOR_API
	help
	  Enable support library for Index for Air Quality (IAQ)
	  with Bosch Sensortec Environmental Cluster (BSEC)
	  and the BME68X Sensor API.

if MY_BME68X_IAQ

config MY_BME68X_IAQ_AMBIENT_TEMP
	int "Expected ambient temperature"
	default 20
	help
	  Initial ambient temperature used to computer heater resistance
	  in degree Celsius.

config MY_BME68X_IAQ_NVS
	bool "Non Volatile Storage"
	depends on NVS
	help
	  Enable support for BSEC state persistence to Flash storage with NVS.

	  When this NVS support is enabled, the library will always try
	  to load a saved BSEC state during its initialization,
	  regardless of MY_BME68X_IAQ_STATE_SAVE_INTVL.

config MY_BME68X_IAQ_STATE_SAVE_INTVL
	int "BSEC state save interval"
	depends on MY_BME68X_IAQ_NVS
	default 1440
	help
	  When the Non Volatile Storage support is available,
	  this library's IAQ control loop will periodically save
	  the BSEC algorithm state to flash memory.

	  This is the periodicity in minutes,
	  e.g. 1440 to save the algorthim state once a day.

	  Set this option to zero to disable periodic BSEC state persistence.

menu "IAQ configuration"

choice
	prompt "Sample rate"
	default MY_BME68X_IAQ_SAMPLE_RATE_LP
	help
	  BSEC sensors sample rate.

	config MY_BME68X_IAQ_SAMPLE_RATE_LP
		bool "1/3 Hz (LP)"
		help
		  Low Power mode.

	  	  Low power (LP) mode is designed for interactive applications
	  	  where the air quality is tracked and observed at a higher update rate
	  	  of 3 seconds with a current consumption of <1 mA.


	config MY_BME68X_IAQ_SAMPLE_RATE_ULP
		bool "1/300 Hz (ULP)"
		help
		  Ultra Low Power mode.

	  	  Ultra low power (ULP) mode is designed for battery-powered and/or
	  	  frequency-coupled devices over extended periods of time.
		  This mode features an update rate of 300 seconds
	  	  and an average current consumption of <0.1 mA.

endchoice
config MY_BME68X_IAQ_SAMPLE_RATE
	 string
	 default "300s" if MY_BME68X_IAQ_SAMPLE_RATE_ULP
	 default "3s" if MY_BME68X_IAQ_SAMPLE_RATE_LP

choice
	prompt "Supply voltage"
	default MY_BME68X_IAQ_33V

config MY_BME68X_IAQ_33V
	bool "3.3 V"
config MY_BME68X_IAQ_18V
	bool "1.8 V"

endchoice # "Supply voltage"
config MY_BME68X_IAQ_VDD
	 string
	 default "33v" if MY_BME68X_IAQ_33V
	 default "18v" if MY_BME68X_IAQ_18V

choice
	prompt "Calibration time"
	default MY_BME68X_IAQ_4D

config MY_BME68X_IAQ_4D
	bool "4 days"
config MY_BME68X_IAQ_28D
	bool "28 days"

endchoice # "Calibrarion time"
config MY_BME68X_IAQ_CALIB_TIME
	 string
	 default "4d" if MY_BME68X_IAQ_4D
	 default "28d" if MY_BME68X_IAQ_28D

endmenu # "IAQ configuration"

choice MY_BME68X_IAQ_LOG_LEVEL_CHOICE
	prompt "Max compiled-in log level"
	default MY_BME68X_IAQ_LOG_LEVEL_DEFAULT
	depends on LOG

config MY_BME68X_IAQ_LOG_LEVEL_OFF
	bool "Off"

config MY_BME68X_IAQ_LOG_LEVEL_ERR
	bool "Error"

config MY_BME68X_IAQ_LOG_LEVEL_WRN
	bool "Warning"

config MY_BME68X_IAQ_LOG_LEVEL_INF
	bool "Info"

config MY_BME68X_IAQ_LOG_LEVEL_DBG
	bool "Debug"

config MY_BME68X_IAQ_LOG_LEVEL_DEFAULT
	bool "Default"

endchoice

config MY_BME68X_IAQ_LOG_LEVEL
	int
	depends on LOG
	default 0 if MY_BME68X_IAQ_LOG_LEVEL_OFF
	default 1 if MY_BME68X_IAQ_LOG_LEVEL_ERR
	default 2 if MY_BME68X_IAQ_LOG_LEVEL_WRN
	default 3 if MY_BME68X_IAQ_LOG_LEVEL_INF
	default 4 if MY_BME68X_IAQ_LOG_LEVEL_DBG
	default LOG_DEFAULT_LEVEL if MY_BME68X_IAQ_LOG_LEVEL_DEFAULT

endif # MY_BME68X_IAQ
```
